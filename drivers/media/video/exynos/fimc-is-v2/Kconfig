## drivers/media/video/exynos/fimc-is-v2/Kconfig
```kconfig
config VIDEO_EXYNOS_FIMC_IS
	bool "Exynos FIMC-IS (Image Subsystem) driver"
	depends on VIDEO_EXYNOS && ARCH_EXYNOS4
	default n
	help
	  This is a v4l2 subdev driver for samsung FIMC-IS device.
config VIDEO_EXYNOS_FIMC_IS_BAYER
	bool "Enable FIMC-IS bayer write"
	depends on VIDEO_EXYNOS_FIMC_IS
	default n
	help
	  Enable to write bayer output image.
config VIDEO_EXYNOS_FIMC_IS_BINNING_2X2
	bool "Enable FIMC-IS binning mode"
	depends on VIDEO_EXYNOS_FIMC_IS
	default n
	help
	  Enable to fimc-is binning mode.
```
